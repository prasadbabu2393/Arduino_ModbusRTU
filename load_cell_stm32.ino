
#include<HardwareSerial.h>

#define RXD2 16  //esp32 Rx
#define TXD2 17  //esp32 Tx

const int DOUT_PIN = 22;
const int SCK_PIN = 23;

int gain = 128, GAIN = 1;
int CMode = 0;

const int calib = 32;  // Set your reset button pin
int programState = 0,buttonState, c = 0;
long buttonMillis = 0;

// Define structures for reading data into.
signed long num = 0;

uint8_t data[3] = { 0 };
uint8_t filler = 0x00;
uint8_t tx_data[9];
float in_kg;

union FloatToBytes {
  float value;
  uint8_t bytes[4];
};
FloatToBytes converter;
int offset = -56693 , kg_weight = 39276, calib_weight = 1000;
float grams_fun;

///////////      shifting function
uint8_t shiftInSlow(uint8_t bitOrder)
{
    uint8_t value = 0;
    uint8_t i;

    for(i = 0; i < 8; ++i)
    {
       digitalWrite(SCK_PIN, HIGH);  //sck high
       delayMicroseconds(1);
        if(bitOrder == LSBFIRST)
        {
            value |= digitalRead(DOUT_PIN) << i; //dout reading
            // Serial.println("lsb bits");
            // Serial.println(value);
        }
        else
        {
            value |= digitalRead(DOUT_PIN) << (7 - i);     //dout reading
            // Serial.println("msb bits");
            // Serial.println(value);
        }
        digitalWrite(SCK_PIN, LOW); //sck low
        delayMicroseconds(1);
    }
    return value;
}

///////////      read function
signed long read()
{
//	 Define structures for reading data into.

		// Pulse the clock pin 24 times to read the data.
			data[2] = shiftInSlow( MSBFIRST);
			data[1] = shiftInSlow( MSBFIRST);
			data[0] = shiftInSlow( MSBFIRST);

			// Set the channel and the gain factor for the next reading using the clock pin.
			for (unsigned int i = 0; i < GAIN; i++)
			{
				digitalWrite(SCK_PIN, HIGH);
				delayMicroseconds(1);
				digitalWrite(SCK_PIN, LOW);
				delayMicroseconds(1);
			}

			// Replicate the most significant bit to pad out a 32-bit signed integer
				if (data[2] & 0x80) 
        {
					filler = 0xFF;
				} 
        else 
        {
					filler =0; // = 0x00;
				}

				// Construct a 32-bit signed integer
			//	num = ((unsigned long)filler << 24) | ((unsigned long)data[2] << 16) | ((unsigned long)data[1] << 8) | (unsigned long)data[0];
         num = ((signed long)filler << 24) | ((signed long)data[2] << 16) | ((signed long)data[1] << 8) | (signed long)data[0];
				return (num);
}

///////////      average function
long read_average(uint8_t times)
{
	long sum = 0;
	for (uint8_t i = 0; i < times; i++) 
  {
		sum += read();
		// Probably will do no harm on AVR but will feed the Watchdog Timer (WDT) on ESP.
		// https://github.com/bogde/HX711/issues/73
	  //delay(4);
	}
	return sum / times;
}
///////////////  weight function
float weight_fun(int update, int off, int kg_wei)
{
  
  float res = (-off + update)*calib_weight/kg_wei;
  return res;
}

///////////////    received rxdata function
void rec_fun(uint8_t* data_rx, uint8_t count_rx)
{
  if(data_rx[0] == 1)
  {
    if(data_rx[1] == 0x03)
    {
      
      tx_data[0] = data_rx[0];  // slave id
      tx_data[1] = data_rx[1];  //fun code
      tx_data[2] = 4;        // no. of bytes to send
      
      for (int i = 0; i < 4; i++)
      {
        //Serial.print(converter.bytes[i], HEX);
        tx_data[3] = converter.bytes[3];      //data
        tx_data[4] = converter.bytes[2];      //data         
        tx_data[5] = converter.bytes[1];      //data     
        tx_data[6] = converter.bytes[0];      //data     
      }

      uint16_t crc = crc16(tx_data, 7);  // Compute CRC for tx_data[0] to tx_data[6]

      tx_data[7] = crc & 0xFF;       // Low byte of CRC
      tx_data[8] = (crc >> 8) & 0xFF;  // High byte of CRC


         // Print the data to Serial for debugging
            Serial.print("Sending: ");
            for (int i = 0; i < 9; i++) 
            {
                Serial.print(tx_data[i], HEX);
                Serial.print(" ");
            }
    }
  }
}





/* Table of CRC values for high-order byte */
static const uint8_t table_crc_hi[] = {
  0x00, 0xC1, 0x81, 0x40, 0x01, 0xC0, 0x80, 0x41, 0x01, 0xC0,
  0x80, 0x41, 0x00, 0xC1, 0x81, 0x40, 0x01, 0xC0, 0x80, 0x41,
  0x00, 0xC1, 0x81, 0x40, 0x00, 0xC1, 0x81, 0x40, 0x01, 0xC0,
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  0x80, 0x41, 0x00, 0xC1, 0x81, 0x40
};

/* Table of CRC values for low-order byte */
static const uint8_t table_crc_lo[] = {
  0x00, 0xC0, 0xC1, 0x01, 0xC3, 0x03, 0x02, 0xC2, 0xC6, 0x06,
  0x07, 0xC7, 0x05, 0xC5, 0xC4, 0x04, 0xCC, 0x0C, 0x0D, 0xCD,
  0x0F, 0xCF, 0xCE, 0x0E, 0x0A, 0xCA, 0xCB, 0x0B, 0xC9, 0x09,
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  0x43, 0x83, 0x41, 0x81, 0x80, 0x40
};






void setup() 
{
  // put your setup code here, to run once:
  Serial.begin(115200);

  pinMode(35, OUTPUT);  // RE & DE
  pinMode(34, OUTPUT);  // RE & DE

  Serial2.begin(19200, SERIAL_8E1, RXD2, TXD2);  // uart_begin
  //CMode = 1;

  pinMode(DOUT_PIN, INPUT);
  pinMode(SCK_PIN, OUTPUT);

  pinMode(calib, INPUT_PULLUP);  // Set the reset pin as input with internal pull-up resistor(default state is high)
  digitalWrite(calib, HIGH);
}

void loop() 
{  
  // put your main code here, to run repeatedly:

  /////////////  calibration function
  while(CMode)
  {

    Serial.println("Entering calibration mode, remove known weight");
    delay(500);
    //should wait on while
    if(digitalRead(DOUT_PIN) == 0)   // if dout low
	  {
		    offset = read_average(10);
        Serial.println("offset");
        Serial.println(offset);
    }   
    Serial. println("put known weight and enter value");
    while(Serial.available() < 1) 
    {}
    if(Serial.available())
    {
      calib_weight = Serial.parseInt();
        Serial.println("calib weight");
        Serial.println(calib_weight);
      if(digitalRead(DOUT_PIN) == 0)   // if dout low
	    {
		    kg_weight = read_average(10)-offset;
        Serial.println("weight");
        Serial.println(kg_weight);
        CMode = 0;
      }   
    }
    
  }

  //////////////   receiving frame 
if (Serial2.available() > 0) 
  {
    uint8_t rx_count = 8;   // receiving frame {id, funcode, addr, no bytes, CRC} = 8bytes
    uint8_t RxData[8];
    Serial2.readBytes(RxData, rx_count);    
    // for(int x=0; x<rx_count; x++)
    // {
    //   Serial.println("hi");
    //   Serial.println(RxData[x]);
    // }
    rec_fun(RxData, rx_count);
    Serial2.write(tx_data, 9);
  }  

  /////////////////     weight knowing 
  if(digitalRead(DOUT_PIN) == 0)   // if dout low
  {
     long result = read_average(10);
      in_kg = weight_fun(result, offset, kg_weight); 
      converter.value = in_kg;
      Serial.print("weight: ");
      Serial.println((String)in_kg + " grams");
      //delay(4000);
  }

  /////////////////calib button 
  unsigned long currentMillis = millis();
  buttonState = digitalRead(calib);
  if (buttonState == LOW && programState == 0) 
  {
    buttonMillis = currentMillis;
    programState = 1;
  } 
  else if (programState == 1 && buttonState == HIGH) 
  {
    programState = 0;  //reset
  }
  if (((currentMillis - buttonMillis) > 3000) && programState == 1) 
  {
    programState = 0;
    //ledMillis = currentMillis;
    Serial.println(" entering into calibration mode");
    CMode = 1;
  }
}
//////////////    CRC Fun 
uint16_t crc16(uint8_t *buffer, uint16_t buffer_length) 
{
  uint8_t crc_hi = 0xFF; /* high CRC byte initialized */
  uint8_t crc_lo = 0xFF; /* low CRC byte initialized */
  unsigned int i;        /* will index into CRC lookup */

  /* pass through message buffer */
  while (buffer_length--) {
    i = crc_lo ^ *buffer++; /* calculate the CRC  */
    crc_lo = crc_hi ^ table_crc_hi[i];
    crc_hi = table_crc_lo[i];
  }

  return (crc_hi << 8 | crc_lo);
}




